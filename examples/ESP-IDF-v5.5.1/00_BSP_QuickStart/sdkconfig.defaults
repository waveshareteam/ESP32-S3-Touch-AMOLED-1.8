## examples/ESP-IDF-v5.5.1/00_BSP_QuickStart/sdkconfig.defaults
```kconfig
CONFIG_IDF_TARGET="esp32s3"
CONFIG_ESPTOOLPY_FLASHMODE_QIO=y
CONFIG_ESPTOOLPY_FLASHSIZE_16MB=y
CONFIG_PARTITION_TABLE_CUSTOM=y
CONFIG_PARTITION_TABLE_CUSTOM_FILENAME="partitions.csv"
CONFIG_COMPILER_OPTIMIZATION_PERF=y
CONFIG_ESP_DEFAULT_CPU_FREQ_MHZ_240=y
CONFIG_ESP32S3_DATA_CACHE_LINE_64B=y
CONFIG_FREERTOS_HZ=1000
CONFIG_SPIRAM=y
CONFIG_SPIRAM_MODE_OCT=y
CONFIG_SPIRAM_SPEED_80M=y
CONFIG_SPIRAM_FETCH_INSTRUCTIONS=y
CONFIG_SPIRAM_RODATA=y
CONFIG_LV_FONT_MONTSERRAT_14=y
CONFIG_LV_FONT_MONTSERRAT_18=y
CONFIG_LV_FONT_MONTSERRAT_24=y
CONFIG_LV_USE_PERF_MONITOR=y
CONFIG_LV_ATTRIBUTE_FAST_MEM_USE_IRAM=y
```

## examples/ESP-IDF-v5.5.1/04_SD_MMC/sdkconfig.defaults
```kconfig
CONFIG_FATFS_VFS_FSTAT_BLKSIZE=4096
CONFIG_EXAMPLE_FORMAT_IF_MOUNT_FAILED=y
CONFIG_EXAMPLE_FORMAT_SD_CARD=y
CONFIG_EXAMPLE_SDMMC_BUS_WIDTH_1=y
CONFIG_EXAMPLE_PIN_CMD=1
CONFIG_EXAMPLE_PIN_CLK=2
CONFIG_EXAMPLE_PIN_D0=3
CONFIG_SPIRAM=y
CONFIG_SPIRAM_MODE_OCT=y
CONFIG_SPIRAM_SPEED_80M=y
CONFIG_SPIRAM_USE_MALLOC=y
CONFIG_SPIRAM_MALLOC_ALWAYSINTERNAL=16384
CONFIG_SPIRAM_MALLOC_RESERVE_INTERNAL=32768
```

## examples/ESP-IDF-v5.5.1/08_i2c_tools/main/Kconfig.projbuild
```kconfig
menu "Example I2C console configuration"
    config EXAMPLE_I2C_MASTER_SDA
        int "I2C SDA GPIO"
        default 15

    config EXAMPLE_I2C_MASTER_SCL
        int "I2C SCL GPIO"
        default 14

    config EXAMPLE_I2C_MASTER_FREQ_HZ
        int "I2C clock frequency"
        default 400000
endmenu
```

## examples/esp-idf/05_gpio_io/main/Kconfig.projbuild
```kconfig
menu "Example GPIO configuration"
    config EXAMPLE_GPIO_OUTPUT
        int "Output GPIO number"
        default -1
        help
            Set to an exposed, unused GPIO. Leave at -1 to run in no-hardware dry-run mode.

    config EXAMPLE_GPIO_INPUT
        int "Input GPIO number"
        default -1
        help
            Set to an exposed, unused GPIO. For loopback tests, connect this pin to the output GPIO.

    config EXAMPLE_GPIO_INPUT_PULLUP
        bool "Enable input pull-up"
        default y
endmenu
```

## examples/esp-idf/06_gpio_interrupt/main/Kconfig.projbuild
```kconfig
menu "Example GPIO interrupt configuration"
    config EXAMPLE_GPIO_INPUT
        int "Interrupt input GPIO number"
        default -1
        help
            Set to an exposed, unused GPIO. Leave at -1 to run in no-hardware dry-run mode.

    config EXAMPLE_GPIO_INPUT_PULLUP
        bool "Enable input pull-up"
        default y

    config EXAMPLE_DEBOUNCE_MS
        int "Debounce time in milliseconds"
        default 50
endmenu
```

## examples/esp-idf/09_sdmmc/sdkconfig.defaults
```kconfig
CONFIG_IDF_TARGET="esp32s3"
CONFIG_ESPTOOLPY_FLASHMODE_QIO=y
CONFIG_ESPTOOLPY_FLASHSIZE_16MB=y
CONFIG_SPIRAM=y
CONFIG_SPIRAM_MODE_OCT=y
CONFIG_SPIRAM_SPEED_80M=y
CONFIG_FREERTOS_HZ=1000
CONFIG_ESP_DEFAULT_CPU_FREQ_MHZ_240=y
CONFIG_ESP32S3_DATA_CACHE_LINE_64B=y
```

## examples/esp-idf/10_wifi_station/main/Kconfig.projbuild
```kconfig
menu "Example Wi-Fi station configuration"
    config ESP_WIFI_SSID
        string "Wi-Fi SSID"
        default ""

    config ESP_WIFI_PASSWORD
        string "Wi-Fi password"
        default ""

    config ESP_MAXIMUM_RETRY
        int "Maximum retry count"
        default 5

    choice ESP_WIFI_SCAN_AUTH_MODE_THRESHOLD
        prompt "Minimum auth mode"
        default ESP_WIFI_AUTH_WPA2_PSK
        config ESP_WIFI_AUTH_OPEN
            bool "Open"
        config ESP_WIFI_AUTH_WEP
            bool "WEP"
        config ESP_WIFI_AUTH_WPA_PSK
            bool "WPA PSK"
        config ESP_WIFI_AUTH_WPA2_PSK
            bool "WPA2 PSK"
        config ESP_WIFI_AUTH_WPA_WPA2_PSK
            bool "WPA/WPA2 PSK"
        config ESP_WIFI_AUTH_WPA3_PSK
            bool "WPA3 PSK"
        config ESP_WIFI_AUTH_WPA2_WPA3_PSK
            bool "WPA2/WPA3 PSK"
    endchoice
endmenu
```

## examples/esp-idf/12_I2SCodec/main/Kconfig.projbuild
```kconfig
menu "Example audio configuration"
    choice EXAMPLE_AUDIO_MODE
        prompt "Audio mode"
        default EXAMPLE_MODE_MUSIC
        config EXAMPLE_MODE_MUSIC
            bool "Speaker sine wave"
        config EXAMPLE_MODE_ECHO
            bool "Microphone echo"
    endchoice

    config EXAMPLE_SAMPLE_RATE
        int "Sample rate"
        default 22050

    config EXAMPLE_VOICE_VOLUME
        int "Speaker volume"
        default 70

    config EXAMPLE_TONE_HZ
        int "Music test tone frequency"
        default 440
endmenu
```

## examples/esp-idf/12_i2s_codec/main/Kconfig.projbuild
```kconfig
menu "Example audio configuration"
    config EXAMPLE_SAMPLE_RATE
        int "Sample rate"
        range 8000 48000
        default 22050

    config EXAMPLE_VOICE_VOLUME
        int "Speaker volume"
        range 0 100
        default 70

    config EXAMPLE_V2_VOICE_VOLUME
        int "V2 speaker volume"
        range 0 100
        default 90
        help
            Applied when the CST816 touch controller identifies V2 hardware.
            Original hardware continues to use EXAMPLE_VOICE_VOLUME.

    config EXAMPLE_TONE_HZ
        int "Music test tone frequency"
        range 100 2000
        default 440
endmenu
```

## examples/esp-idf/14_lvgl_demo_v9/sdkconfig.defaults
```kconfig
CONFIG_IDF_TARGET="esp32s3"
CONFIG_ESPTOOLPY_FLASHMODE_QIO=y
CONFIG_ESPTOOLPY_FLASHSIZE_16MB=y
CONFIG_SPIRAM=y
CONFIG_SPIRAM_MODE_OCT=y
CONFIG_SPIRAM_SPEED_80M=y
CONFIG_FREERTOS_HZ=1000
CONFIG_ESP_DEFAULT_CPU_FREQ_MHZ_240=y
CONFIG_ESP32S3_DATA_CACHE_LINE_64B=y
CONFIG_PARTITION_TABLE_CUSTOM=y
CONFIG_PARTITION_TABLE_CUSTOM_FILENAME="partitions.csv"
CONFIG_LV_FONT_MONTSERRAT_14=y
CONFIG_LV_FONT_MONTSERRAT_24=y
CONFIG_LV_USE_DEMO_WIDGETS=y
```
