## examples/ESP-IDF-v5.3.2/04_SD_MMC/sdkconfig.defaults
```kconfig
CONFIG_FATFS_VFS_FSTAT_BLKSIZE=4096
CONFIG_EXAMPLE_FORMAT_IF_MOUNT_FAILED=y
CONFIG_EXAMPLE_FORMAT_SD_CARD=y
CONFIG_EXAMPLE_SDMMC_BUS_WIDTH_1=y
CONFIG_EXAMPLE_PIN_CMD=1
CONFIG_EXAMPLE_PIN_CLK=2
CONFIG_EXAMPLE_PIN_D0=3
```
